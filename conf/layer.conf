## conf/layer.conf
```bitbake
# We have a conf and classes directory, add to BBPATH
BBPATH .= ":${LAYERDIR}"

# We have recipes-* directories, add to BBFILES
BBFILES += "${LAYERDIR}/recipes-*/*/*.bb \
            ${LAYERDIR}/recipes-*/*/*.bbappend"

BBFILE_COLLECTIONS += "meta-breakpoint-module"
BBFILE_PATTERN_meta-breakpoint-module = "^${LAYERDIR}/"
BBFILE_PRIORITY_meta-breakpoint-module = "6"

#LAYERDEPENDS_meta-breakpoint-module = "core"
LAYERSERIES_COMPAT_meta-breakpoint-module = "nanbield scarthgap"
```
